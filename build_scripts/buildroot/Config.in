## build_scripts/buildroot/Config.in
```kconfig
source "$BR2_EXTERNAL_AD5M_PATH/package/python-ff-ad5m-audio/Config.in"
source "$BR2_EXTERNAL_AD5M_PATH/package/python-ff-ad5m-backlight/Config.in"
source "$BR2_EXTERNAL_AD5M_PATH/package/klippain-shaketune/Config.in"
source "$BR2_EXTERNAL_AD5M_PATH/package/klipper/Config.in"
source "$BR2_EXTERNAL_AD5M_PATH/package/moonraker/Config.in"
source "$BR2_EXTERNAL_AD5M_PATH/package/mainsail/Config.in"
source "$BR2_EXTERNAL_AD5M_PATH/package/fluidd/Config.in"
source "$BR2_EXTERNAL_AD5M_PATH/package/klipperscreen/Config.in"
source "$BR2_EXTERNAL_AD5M_PATH/package/guppyscreen/Config.in"
source "$BR2_EXTERNAL_AD5M_PATH/package/libhubbub/Config.in"
source "$BR2_EXTERNAL_AD5M_PATH/package/libparserutils/Config.in"
source "$BR2_EXTERNAL_AD5M_PATH/package/libwapcaplet/Config.in"
```

## build_scripts/buildroot/package/fluidd/Config.in
```kconfig
config BR2_PACKAGE_FLUIDD
	bool "fluidd"
	help
	  Fluidd, the klipper UI.

	  https://github.com/fluidd-core/fluidd
```

## build_scripts/buildroot/package/guppyscreen/Config.in
```kconfig
config BR2_PACKAGE_GUPPYSCREEN
	bool "guppyscreen"
	depends on BR2_PACKAGE_WPA_SUPPLICANT
	depends on BR2_PACKAGE_MOONRAKER
    select BR2_PACKAGE_LIBEVDEV
	select BR2_PACKAGE_LIBEVENT
	help
	  A native Touch UI for 3D Printers running Klipper/Moonraker.

	  https://github.com/ballaswag/guppyscreen
```

## build_scripts/buildroot/package/klippain-shaketune/Config.in
```kconfig
config BR2_PACKAGE_KLIPPAIN_SHAKETUNE
	bool "klippain-shaketune"
	depends on BR2_PACKAGE_PYTHON3
	depends on BR2_PACKAGE_KLIPPER
	select BR2_PACKAGE_PYTHON_GIT
	select BR2_PACKAGE_PYTHON_MATPLOTLIB
	select BR2_PACKAGE_PYTHON_NUMPY
	select BR2_PACKAGE_PYTHON_SCIPY
	select BR2_PACKAGE_PYTHON_PYWAVELETS
	select BR2_PACKAGE_PYTHON_ZSTANDARD
	select BR2_PACKAGE_OPENBLAS
	help
	  Klipper streamlined input shaper workflow and calibration tools

	  https://github.com/Frix-x/klippain-shaketune
```

## build_scripts/buildroot/package/klipper/Config.in
```kconfig
config BR2_PACKAGE_KLIPPER
	bool "klipper"
	depends on BR2_PACKAGE_PYTHON3
	select BR2_PACKAGE_PYTHON_GREENLET
	select BR2_PACKAGE_PYTHON_CFFI
	select BR2_PACKAGE_PYTHON_JINJA2
	select BR2_PACKAGE_PYTHON_MARKUPSAFE
	select BR2_PACKAGE_PYTHON_SERIAL
	select BR2_PACKAGE_PYTHON_CAN
	select BR2_PACKAGE_PYTHON_SETUPTOOLS
	select BR2_PACKAGE_PYTHON_MSGSPEC
	help
	  Klipper is a 3d-printer firmware

	  https://github.com/Klipper3d/klipper

config BR2_PACKAGE_KLIPPER_CONFIGS
    string "Klipper MCU Configuration Files"
    depends on BR2_PACKAGE_KLIPPER
    help
      Specify a space-separated list of MCU configuration files for firmware 
      compilation. Each file must be a valid Klipper configuration file in 
      the .config format.

      Example: "/path/to/mcu1.config /path/to/mcu2.config"

      Note: Configuration file names must be unique.

      If this field is left empty, no firmware will be generated.
```

## build_scripts/buildroot/package/klipperscreen/Config.in
```kconfig
config BR2_PACKAGE_KLIPPERSCREEN
	bool "klipperscreen"
	depends on BR2_PACKAGE_MOONRAKER
	depends on BR2_PACKAGE_PYTHON_SDBUS_NETWORKMANAGER || (BR2_PACKAGE_IWD && BR2_PACKAGE_DBUS)
	select BR2_PACKAGE_LIBEVDEV
	select BR2_PACKAGE_PYTHON_JINJA2
	select BR2_PACKAGE_PYTHON_REQUESTS
	select BR2_PACKAGE_PYTHON_MPV
	select BR2_PACKAGE_PYTHON_GOBJECT
	select BR2_PACKAGE_PYTHON_PYCAIRO
	select BR2_PACKAGE_PYTHON_WEBSOCKET_CLIENT
	select BR2_PACKAGE_PYTHON_PSUTIL
	help
	  GUI for Klipper

	  https://github.com/KlipperScreen/KlipperScreen
```

## build_scripts/buildroot/package/libdom/Config.in
```kconfig
config BR2_PACKAGE_LIBDOM
	bool "libdom"
	select BR2_PACKAGE_LIBWAPCAPLET
        select BR2_PACKAGE_LIBHUBBUB
        select BR2_PACKAGE_LIBPARSERUTILS
	help
          LibDOM is an implementation of the W3C DOM, written in C. 
          It is currently in development for use with NetSurf and is 
          intended to be suitable for use in other projects too.

	  http://www.netsurf-browser.org/projects/libdom/
```

## build_scripts/buildroot/package/libhubbub/Config.in
```kconfig
config BR2_PACKAGE_LIBHUBBUB
	bool "libhubbub"
        select BR2_PACKAGE_LIBWAPCAPLET
	help
          Hubbub is an HTML5 compliant parsing library, written in C. 
          It was developed as part of the NetSurf project
	  Libsvgtiny is an implementation of SVG Tiny, written in C.

	  http://www.netsurf-browser.org/projects/hubbub
```

## build_scripts/buildroot/package/libparserutils/Config.in
```kconfig
config BR2_PACKAGE_LIBPARSERUTILS
	bool "libparserutils"
	help
          LibParserUtils is a library for building efficient parsers, written in C. 
          It was developed as part of the NetSurf project

          https://www.netsurf-browser.org/projects/libparserutils/
```

## build_scripts/buildroot/package/libsvgtiny-pixbuf/Config.in
```kconfig
config BR2_PACKAGE_LIBSVGTINY_PIXBUF
	bool "libsvgtiny-pixbuf"
    select BR2_PACKAGE_LIBSVGTINY
    select BR2_PACKAGE_CAIRO
    select BR2_PACKAGE_LIBXML2
    select BR2_PACKAGE_GDK_PIXBUF
	help
	  Lightweight SVG loader for gdk-pixbuf without dependency to librsvg
```

## build_scripts/buildroot/package/libsvgtiny/Config.in
```kconfig
config BR2_PACKAGE_LIBSVGTINY
	bool "libsvgtiny"
		select BR2_PACKAGE_LIBDOM
        select BR2_PACKAGE_LIBWAPCAPLET
	help
	  Libsvgtiny is an implementation of SVG Tiny, written in C.
	  It is currently in development for use with NetSurf and is
	  intended to be suitable for use in other projects too.

	  http://www.netsurf-browser.org/projects/libsvgtiny/
```

## build_scripts/buildroot/package/libwapcaplet/Config.in
```kconfig
config BR2_PACKAGE_LIBWAPCAPLET
	bool "libwapcaplet"
	help
          LibWapcaplet is a string internment library, written in C. 
          It provides reference counted string interment and rapid string 
          comparison functionality. It was developed as part of the NetSurf project.

          https://www.netsurf-browser.org/projects/libwapcaplet/
```

## build_scripts/buildroot/package/mainsail/Config.in
```kconfig
config BR2_PACKAGE_MAINSAIL
	bool "mainsail"
	help
	  Mainsail is the popular web interface for managing and controlling 3D printers with Klipper.

	  https://github.com/mainsail-crew/mainsail
```

## build_scripts/buildroot/package/moonraker/Config.in
```kconfig
config BR2_PACKAGE_MOONRAKER
	bool "moonraker"
	depends on BR2_PACKAGE_KLIPPER
	depends on BR2_PACKAGE_PYTHON3
	select BR2_PACKAGE_PYTHON_DBUS_NEXT
	select BR2_PACKAGE_PYTHON_TORNADO
	select BR2_PACKAGE_PYTHON_SERIAL
	select BR2_PACKAGE_PYTHON_PILLOW
	select BR2_PACKAGE_PYTHON_DISTRO
	select BR2_PACKAGE_PYTHON_INOTIFY_SIMPLE
	select BR2_PACKAGE_PYTHON_PYNACL
	select BR2_PACKAGE_PYTHON_PAHO_MQTT
	select BR2_PACKAGE_PYTHON_ZEROCONF
	select BR2_PACKAGE_PYTHON_JINJA2
	select BR2_PACKAGE_PYTHON_DBUS_FAST
	select BR2_PACKAGE_PYTHON_APPRISE
	select BR2_PACKAGE_PYTHON_LDAP3
	select BR2_PACKAGE_PYTHON_PERIPHERY
	select BR2_PACKAGE_PYTHON_IMPORTLIB_METADATA
	select BR2_PACKAGE_PYTHON_STREAMING_FORM_DATA
	select BR2_PACKAGE_PYTHON_PREPROCESS_CANCELLATION
	select BR2_PACKAGE_PYTHON_UVLOOP
	select BR2_PACKAGE_PYTHON_PRE_COMMIT
	select BR2_PACKAGE_PYTHON_LIBNACL
	help
	  Web API Server for Klipper

	  https://github.com/Arksine/moonraker
```

## build_scripts/buildroot/package/python-ff-ad5m-audio/Config.in
```kconfig
config BR2_PACKAGE_PYTHON_FF_AD5M_AUDIO
	bool "python-ff-ad5m-audio"
	select BR2_PACKAGE_PYTHON_MIDO
	help
	  Basic audio tool for pwm frequency and midi sound.

	  https://github.com/consp/flashforge_ad5m_audio
```

## build_scripts/buildroot/package/python-ff-ad5m-backlight/Config.in
```kconfig
config BR2_PACKAGE_PYTHON_FF_AD5M_BACKLIGHT
	bool "python-ff-ad5m-backlight"
	help
	  Basic tool for managing the backlight of the FlashForge Adventurer 5m (Pro)

	  https://github.com/consp/flashforge_ad5m_backlight
```

## build_scripts/buildroot/package/python-mido/Config.in
```kconfig
config BR2_PACKAGE_PYTHON_MIDO
	bool "python-mido"
	select BR2_PACKAGE_PYTHON_PACKAGING
	help
	  Mido is a library for working with MIDI messages and ports.

	  https://github.com/mido/mido
```

## build_scripts/buildroot/package/ustreamer/Config.in
```kconfig
config BR2_PACKAGE_USTREAMER
	bool "ustreamer"
	depends on BR2_TOOLCHAIN_HEADERS_AT_LEAST_3_16 # V4L2_EVENT_SOURCE_CHANGE
	depends on BR2_TOOLCHAIN_HAS_THREADS
	depends on BR2_USE_MMU
	depends on !BR2_STATIC_LIBS
	depends on BR2_TOOLCHAIN_HAS_ATOMIC
	select BR2_PACKAGE_JPEG
	select BR2_PACKAGE_LIBEVENT
	select BR2_PACKAGE_LIBBSD
	select BR2_PACKAGE_LIBGPIOD
	help
	  Lightweight and fast MJPEG-HTTP streamer

	  https://github.com/pikvm/ustreamer

comment "ustreamer needs a toolchain w/ threads, headers >= 3.16, dynamic library"
```
